## Kconfig
```kconfig
mainmenu "RoidsOS Bootloader Configuration"

choice CHOICE_EX
	bool "Choice example"
	config CHOICE_OPTION1
		bool "Option 1"
	config CHOICE_OPTION2
		bool "Option 2"
	---help---
	This is an example
endchoice

menu "Menu Example"
	config INTEGER_EX
		int "Integer example"
		default 10
		---help---
		This is an example

	config BOOLEAN_EX
		bool "Boolean example"
		---help---
		This is an example
endmenu
```
